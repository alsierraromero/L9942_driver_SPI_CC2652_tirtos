/**
 * @cliArgs --board "/ti/boards/LP_CC2652RB" --product "simplelink_cc13x2_26x2_sdk@5.20.00.52"
 * @versions {"data":"2021060817","timestamp":"2021060817","tool":"1.8.2+1992","templates":null}
 */

/**
 * Import the modules used in this configuration.
 */
const Display  = scripting.addModule("/ti/display/Display");
const Display1 = Display.addInstance();
const GPIO     = scripting.addModule("/ti/drivers/GPIO");
const GPIO1    = GPIO.addInstance();
const GPIO2    = GPIO.addInstance();
const GPIO3    = GPIO.addInstance();
const GPIO4    = GPIO.addInstance();
const GPIO5    = GPIO.addInstance();
const PWM      = scripting.addModule("/ti/drivers/PWM", {}, false);
const PWM1     = PWM.addInstance();
const RTOS     = scripting.addModule("/ti/drivers/RTOS");
const SPI      = scripting.addModule("/ti/drivers/SPI");
const SPI1     = SPI.addInstance();
const Timer    = scripting.addModule("/ti/drivers/Timer", {}, false);
const Timer1   = Timer.addInstance();

/**
 * Write custom configuration values to the imported modules.
 */
Display1.$name                    = "CONFIG_Display_0";
Display1.$hardware                = system.deviceData.board.components.XDS110UART;
Display1.uart.$name               = "CONFIG_UART_0";
Display1.uart.dataDirection       = "Send Only";
Display1.uart.txPinInstance.$name = "CONFIG_PIN_0";

GPIO1.$hardware         = system.deviceData.board.components.LED_RED;
GPIO1.$name             = "CONFIG_LED_STALL";
GPIO1.pinInstance.$name = "CONFIG_PIN_2";

GPIO2.$hardware         = system.deviceData.board.components.LED_GREEN;
GPIO2.$name             = "CONFIG_LED_DIR";
GPIO2.pinInstance.$name = "CONFIG_PIN_3";

GPIO3.$name             = "CONFIG_GPIO_STEP_EN";
GPIO3.$hardware         = system.deviceData.board.components["BTN-1"];
GPIO3.interruptTrigger  = "Both Edges";
GPIO3.callbackFunction  = "Callback_GPIO_Step_En";
GPIO3.pinInstance.$name = "CONFIG_PIN_4";

GPIO4.$name             = "CONFIG_GPIO_MOTOR_DIR";
GPIO4.$hardware         = system.deviceData.board.components["BTN-2"];
GPIO4.callbackFunction  = "Callback_GPIO_Dir";
GPIO4.interruptTrigger  = "Rising Edge";
GPIO4.pinInstance.$name = "CONFIG_PIN_5";

GPIO5.$name             = "PWM_Sense_Stall";
GPIO5.callbackFunction  = "Callback_GPIO_Stall_Det";
GPIO5.interruptTrigger  = "Both Edges";
GPIO5.pinInstance.$name = "CONFIG_PIN_11";

PWM1.$name                            = "CONFIG_PWM_1";
PWM1.timerObject.$name                = "CONFIG_GPTIMER_0";
PWM1.timerObject.timer.$assign        = "GPTM1";
PWM1.timerObject.timer.pwmPin.$assign = "boosterpack.19";
PWM1.timerObject.pwmPinInstance.$name = "CONFIG_PIN_9";

const CCFG              = scripting.addModule("/ti/devices/CCFG", {}, false);
CCFG.ccfgTemplate.$name = "ti_devices_CCFGTemplate0";

SPI1.$name                 = "CONFIG_SPI_MASTER";
SPI1.defaultTxBufferValue  = "0xFF";
SPI1.$hardware             = system.deviceData.board.components.MX25R8035F;
SPI1.mode                  = "Four Pin SS Active Low";
SPI1.sclkPinInstance.$name = "CONFIG_PIN_6";
SPI1.misoPinInstance.$name = "CONFIG_PIN_7";
SPI1.mosiPinInstance.$name = "CONFIG_PIN_8";
SPI1.ssPinInstance.$name   = "CONFIG_PIN_1";

Timer1.$name               = "CONFIG_TIMER_0";
Timer1.timerType           = "32 Bits";
Timer1.timerInstance.$name = "CONFIG_GPTIMER_1";

/**
 * Pinmux solution for unlocked pins/peripherals. This ensures that minor changes to the automatic solver in a future
 * version of the tool will not impact the pinmux you originally saw.  These lines can be completely deleted in order to
 * re-solve from scratch.
 */
Display1.uart.uart.$suggestSolution         = "UART1";
Display1.uart.uart.txPin.$suggestSolution   = "boosterpack.4";
GPIO1.gpioPin.$suggestSolution              = "boosterpack.39";
GPIO2.gpioPin.$suggestSolution              = "boosterpack.40";
GPIO3.gpioPin.$suggestSolution              = "boosterpack.13";
GPIO4.gpioPin.$suggestSolution              = "boosterpack.12";
GPIO5.gpioPin.$suggestSolution              = "boosterpack.29";
SPI1.spi.$suggestSolution                   = "SSI0";
SPI1.spi.sclkPin.$suggestSolution           = "boosterpack.7";
SPI1.spi.misoPin.$suggestSolution           = "boosterpack.14";
SPI1.spi.mosiPin.$suggestSolution           = "boosterpack.15";
SPI1.spi.dmaRxChannel.$suggestSolution      = "DMA_CH3";
SPI1.spi.dmaTxChannel.$suggestSolution      = "DMA_CH4";
SPI1.spi.ssPin.$suggestSolution             = "boosterpack.38";
Timer1.timerInstance.timer.$suggestSolution = "GPTM0";
